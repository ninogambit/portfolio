#include <Wire.h>
#include <avr/pgmspace.h>
#include <EEPROM.h>

#define SSD1306_ADDR 0x3C
#define SCREEN_WIDTH 128
#define SCREEN_HEIGHT 64
#define BUTTON_MAIN 2
#define BUTTON_OTHER 3
#define DEBOUNCE_DELAY 30
#define EEPROM_HIGHSCORE_ADDR 0
#define BUZZER_PIN 9
#define LED_PIN 8
#define SCORE_BEEP_DURATION 100 // Duration in ms for score beep

enum ScreenState {
  SPLASH,
  MENU,
  PLAY,
  HIGHSCORE,
  GAME_OVER
};

uint8_t buffer[1024];

const uint8_t textFont[] PROGMEM = {
  0x00,0x00,0x00,0x00,0x00, // space
  0x00,0x00,0x5F,0x00,0x00, // !
  0x00,0x07,0x00,0x07,0x00, // "
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  0x61,0x51,0x49,0x45,0x43, // Z
};


const unsigned char splashScreenBitmap[1024] PROGMEM = {
  0xFF, 0xFF, 0xFF, 0xFF, 0xFF, 0xFF, 0xFF, 0x7F, 0x7F, 0x7F, 0x7F, 0x7F, 0x7F, 0x7F, 0x7F, 0x7F, 
	0x7F, 0x7F, 0x7F, 0x7F, 0x7F, 0x7F, 0x7F, 0x7F, 0x7F, 0x7F, 0x7F, 0x7F, 0x7F, 0x7F, 0x7F, 0x7F, 
	0x7F, 0x7F, 0x7F, 0x7F, 0x7F, 0x7F, 0x7F, 0x7F, 0x7F, 0x7F, 0x7F, 0x7F, 0x7F, 0x7F, 0x7F, 0x7F, 
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	0xFE, 0xFE, 0xFE, 0xFE, 0xFE, 0xFE, 0xFE, 0xFE, 0xFE, 0xFF, 0xFF, 0xFF, 0xFF, 0xFF, 0xFF, 0xFF
};

void clearBuffer() { 
  memset(buffer, 0x00, sizeof(buffer)); // Fills a block of memory with a single byte value
}

void drawBitmap(const uint8_t *bitmap) {
  for (uint16_t i = 0; i < 1024; i++) {
    uint8_t byte = pgm_read_byte(&bitmap[i]);
    buffer[i] = byte;  // copy directly to framebuffer
  }
  updateDisplay();
}

void drawPixel(uint8_t x, uint8_t y, bool on) {
  if (x >= 128 || y >= 64) return;
  uint16_t index = x + (y / 8) * 128;
  uint8_t mask = 1 << (y & 7); // Shift (remainder modulo 8) positions to the left 
  if (on)
    buffer[index] |= mask;
  else
    buffer[index] &= ~mask;
}

/*void drawRect(uint8_t x, uint8_t y, uint8_t w, uint8_t h, bool on) {
  for (uint8_t i = x; i < x + w; i++) {
    for (uint8_t j = y; j < y + h; j++) {
      drawPixel(i, j, on);
    }
  }
}*/

void drawRect(uint8_t x, uint8_t y, uint8_t w, uint8_t h, bool on) {
  if (x >= SCREEN_WIDTH || y >= SCREEN_HEIGHT || w == 0 || h == 0) return;
  // Clip to screen bounds
  if (x + w > SCREEN_WIDTH) w = SCREEN_WIDTH - x;
  if (y + h > SCREEN_HEIGHT) h = SCREEN_HEIGHT - y;

  uint8_t start_page = y / 8;
  uint8_t end_page = (y + h - 1) / 8;
  uint8_t start_mask = 0xFF << (y % 8);
  uint8_t end_mask = (1 << ((y + h - 1) % 8 + 1)) - 1;

  for (uint8_t col = x; col < x + w; col++) {
    for (uint8_t page = start_page; page <= end_page; page++) {
      uint16_t idx = col + page * SCREEN_WIDTH;
      uint8_t mask;
      if (page == start_page && page == end_page) {
        mask = start_mask & end_mask;
      } else if (page == start_page) {
        mask = start_mask;
      } else if (page == end_page) {
        mask = end_mask;
      } else {
        mask = 0xFF;
      }
      if (on) {
        buffer[idx] |= mask;
      } else {
        buffer[idx] &= ~mask;
      }
    }
  }
}

void drawChar(uint8_t x, uint8_t y, char c, bool on) {
  if (c < 32 || c > 90) return; // only basic ASCII
  uint16_t index = (c - 32) * 5;
  for (uint8_t col = 0; col < 5; col++) {
    uint8_t line = pgm_read_byte(&textFont[index + col]);
    for (uint8_t row = 0; row < 8; row++) {
      if (line & (1 << row)) {
       drawPixel(x + col, y + row, on);
      }
    }
  }
}

void drawText(uint8_t x, uint8_t y, const char* str, bool on) {
  while (*str) {
    drawChar(x, y, *str++, on);
    x += 6;  // 5 pixels + 1 spacing
  }
}

void updateDisplay() {
  sendDisplayCommand(0x21); // set column address
  sendDisplayCommand(0); // start column
  sendDisplayCommand(127); // end column
  sendDisplayCommand(0x22); // set page address
  sendDisplayCommand(0); // start page
  sendDisplayCommand(7); // end page

  uint16_t i = 0;
  while (i < 1024) {
    Wire.beginTransmission(SSD1306_ADDR);
    Wire.write(0x40); // Control byte: Co = 0; D/C# = 1 : b01000000
    uint8_t count = 0;
    while (count < 31 && i < 1024) { //. Max 31 data bytes per transmission
      Wire.write(buffer[i]);
      i++;
      count++;
    }
    Wire.endTransmission();
  }

}

void sendDisplayCommand(uint8_t cmd) {
  Wire.beginTransmission(SSD1306_ADDR);
  Wire.write(0x00); // Control byte: Co = 0; D/C# = 0
  Wire.write(cmd);
  Wire.endTransmission();
}

void sendDisplayData(uint8_t data) {
  Wire.beginTransmission(SSD1306_ADDR);
  Wire.write(0x40);  // Control byte: Co = 0; D/C# = 1 : b01000000
  Wire.write(data);
  Wire.endTransmission();
}

void initDisplay() {
  delay(100);
  sendDisplayCommand(0xAE);
  sendDisplayCommand(0xD5); sendDisplayCommand(0x80); // Set display clock divide ratio/osciallatior frequency +
  sendDisplayCommand(0xA8); sendDisplayCommand(0x3F); // Multiplex ratio (1 to 64), 64 MUX for 128x64 +
  sendDisplayCommand(0xD3); sendDisplayCommand(0x00); // Display offset, no offset + 
  sendDisplayCommand(0x40); // Start line at 0 +
  sendDisplayCommand(0x8D); sendDisplayCommand(0x14); // Charge pump setting, Enable charge pump +
  sendDisplayCommand(0x20); sendDisplayCommand(0x00); // Set memory addressing mode, horizontal +
  sendDisplayCommand(0xA1); // Segment remap (column address 127 is mapped to SEG0) (flip horizontally) +
  sendDisplayCommand(0xC8); // COM output scan direction remapped (flip vertically) +
  sendDisplayCommand(0xDA); sendDisplayCommand(0x12); // COM pins hardware config, default for 128x64 +
  sendDisplayCommand(0x81); sendDisplayCommand(0x7F); // Contrast control, cotnrast value( adjust 0x00-0xFF for brightness) +
  sendDisplayCommand(0xD9); sendDisplayCommand(0xF1); // Pre-charge period +
  sendDisplayCommand(0xDB); sendDisplayCommand(0x40); // VCOMH deselect level +
  sendDisplayCommand(0xA4); // Display follows RAM, entire display ON (normal mode) +
  sendDisplayCommand(0xA6); // Normal display (not inverted) +
  sendDisplayCommand(0xAF); // Display ON +
}

// EEPROM functions for high score
int readHighScore() {
  int highScore;
  EEPROM.get(EEPROM_HIGHSCORE_ADDR, highScore);
  if (highScore < 0 || highScore > 9999) {
    highScore = 0;
    EEPROM.put(EEPROM_HIGHSCORE_ADDR, highScore);
  }
  return highScore;
}

void writeHighScore(int score) {
  EEPROM.put(EEPROM_HIGHSCORE_ADDR, score);
}

class Screen {
public:
  virtual void draw() = 0;
  virtual int update() = 0; // 0: no change, -1: redraw, 1: to menu, 2: to play, 3: to highscore
  virtual void reset() {}
};

class SplashScreen : public Screen {
private:
  unsigned long startTime;

public:
  SplashScreen() {
    startTime = millis();
  }

  void draw() {
    clearBuffer();
    drawBitmap(splashScreenBitmap);
  }

  int update() {
    if (millis() - startTime >= 2000) {
      return 1;
    }
    return 0;
  }
};

class MenuScreen : public Screen {
private:
  int selectedOption = 0;  // 0: Play, 1: Highscore
  bool lastSwitchState = HIGH;
  bool lastSelectState = HIGH;
  unsigned long lastSwitchDebounceTime = 0;
  unsigned long lastSelectDebounceTime = 0;
  bool switchStateStable = HIGH;
  bool selectStateStable = HIGH;

public:
  MenuScreen() {
    pinMode(BUTTON_MAIN, INPUT);
    pinMode(BUTTON_OTHER, INPUT);
  }

  void draw() {
    clearBuffer();
    uint8_t menuX = 40;
    if (selectedOption == 0) {
      drawRect(menuX - 2, 18, 60, 12, 1);  // highlight background
      drawText(menuX, 20, "PLAY", 0);      // text in black
      drawText(menuX, 36, "HIGHSCORE", 1); 
    } else {
      drawText(menuX, 20, "PLAY", 1);       // unselected text white
      drawRect(menuX - 2, 34, 60, 12, 1);   // highlight background
      drawText(menuX, 36, "HIGHSCORE", 0); 
    }

    updateDisplay();
  }

  int update() {
    bool currentSwitch = digitalRead(BUTTON_OTHER);
    bool currentSelect = digitalRead(BUTTON_MAIN);
    int result = 0;

    // Debounce main button
    if (currentSwitch != switchStateStable) {
      lastSwitchDebounceTime = millis();
      switchStateStable = currentSwitch;
    }

    if (millis() - lastSwitchDebounceTime >= DEBOUNCE_DELAY) {
      if (lastSwitchState == HIGH && switchStateStable == LOW) {
        selectedOption = 1 - selectedOption;
        result = -1;
      }
      lastSwitchState = switchStateStable;
    }

    // Debounce other button
    if (currentSelect != selectStateStable) {
      lastSelectDebounceTime = millis();
      selectStateStable = currentSelect;
    }
    if (millis() - lastSelectDebounceTime >= DEBOUNCE_DELAY) {
      if (lastSelectState == HIGH && selectStateStable == LOW) {
        result = (selectedOption == 0) ? 2 : 3; // 2: Play, 3: HighScore
      }
      lastSelectState = selectStateStable;
    }

    return result;
  }
};

class PlayScreen : public Screen {
private: 
  bool buzzerOn = false;
  unsigned long buzzerStartTime = 0;

  int playerX = 54; // Start near center
  int playerY = 12;
  int playerSpeed = 1;
  int playerSize = 4; // 4x4 pixel square
  int direction = -1; // 0: right, 1: down, 2: left, 3: up
  int score = 0;
  int prevPlayerX;
  int prevPlayerY;
  unsigned long lastMoveTime = 0;
  const unsigned long moveInterval = 25; // Move every 100 ms
  bool lastSwitchState = HIGH;
  bool switchStateStable = HIGH;

  bool firstDraw = true;
  int prevScore = -1;

  unsigned long lastSwitchDebounceTime = 0;
  // Inner rectangle (centered, 40x20 pixels)
  const int startLineX = 54;
  const int borderSize = 5;
  const int innerRectX = 40;
  const int innerRectY = 20;
  const int innerRectWidth = 46;
  const int innerRectHeight = 22;
  const int topBorderX = 0;
  const int topBorderY = 0;
  const int topBorderWidth = SCREEN_WIDTH;
  const int topBorderHeight = borderSize;
  const int rightBorderX = SCREEN_WIDTH - borderSize;
  const int rightBorderY = 0;
  const int rightBorderWidth = borderSize;
  const int rightBorderHeight = SCREEN_HEIGHT;
  const int leftBorderX = 0;
  const int leftBorderY = 0;
  const int leftBorderWidth = borderSize;
  const int leftBorderHeight = SCREEN_HEIGHT;
  const int bottomBorderX = 0;
  const int bottomBorderY = SCREEN_HEIGHT - borderSize;
  const int bottomBorderWidth = SCREEN_WIDTH;
  const int bottomBorderHeight = borderSize;

  int scoreX = innerRectX + innerRectWidth/2 - 3;
  int scoreY = innerRectY + innerRectHeight/2 - 4;

public:
  PlayScreen() {
    pinMode(BUTTON_MAIN, INPUT);
    reset();
  }

  void reset() {
    buzzerOn = false;
    digitalWrite(BUZZER_PIN, LOW);
    firstDraw = true;
    prevScore = -1;
    playerX = 54;
    playerY = 12;
    direction = -1; 
    lastMoveTime = millis();
    lastSwitchState = HIGH;
    switchStateStable = HIGH;
    score = 0;
    prevPlayerX = playerX;
    prevPlayerY = playerY;
    lastSwitchDebounceTime = 0;
  }

  int getScore() {
    return score;
  }

  /*void draw() {
    clearBuffer();
    drawRect(innerRectX, innerRectY, innerRectWidth, innerRectHeight, 1);
    drawRect(topBorderX, topBorderY, topBorderWidth, topBorderHeight, 1);
    drawRect(rightBorderX, rightBorderY, rightBorderWidth, rightBorderHeight, 1);
    drawRect(leftBorderX, leftBorderY, leftBorderWidth, leftBorderHeight, 1);
    drawRect(bottomBorderX , bottomBorderY, bottomBorderWidth, bottomBorderHeight, 1);
    drawRect(playerX, playerY, playerSize, playerSize, 1);
    drawText(innerRectX + innerRectWidth/2 - 3, innerRectY + innerRectHeight/2 - 4, String(score).c_str(), 0);
    updateDisplay();
  }*/
  
  void draw() {
    if (firstDraw) {
      clearBuffer();
      drawRect(innerRectX, innerRectY, innerRectWidth, innerRectHeight, 1);
      drawRect(topBorderX, topBorderY, topBorderWidth, topBorderHeight, 1);
      drawRect(rightBorderX, rightBorderY, rightBorderWidth, rightBorderHeight, 1);
      drawRect(leftBorderX, leftBorderY, leftBorderWidth, leftBorderHeight, 1);
      drawRect(bottomBorderX , bottomBorderY, bottomBorderWidth, bottomBorderHeight, 1);
      //drawText(innerRectX + innerRectWidth/2 - 3, innerRectY + innerRectHeight/2 - 4, String(score).c_str(), 0);
      firstDraw = false;
    } else {
      // Erase old player
      drawRect(prevPlayerX, prevPlayerY, playerSize, playerSize, 0);
    }

    // Draw new player
    drawRect(playerX, playerY, playerSize, playerSize, 1);

    /*if (score != prevScore) {
      String s = String(score);
      uint8_t textWidth = s.length() * 6;
      //drawRect(scoreX, scoreY, 24, 8, 1);
      //drawText(scoreX, scoreY, s.c_str(), 0);
      //drawText(innerRectX + innerRectWidth/2 - 3, innerRectY + innerRectHeight/2 - 4, String(score).c_str(), 0);
      prevScore = score;
    }*/

     if (score != prevScore) {
      // Clear score area (max 4 digits, 4 * 6 = 24 pixels wide)
      uint8_t maxTextWidth = 24;
      drawRect(innerRectX + 1, scoreY, innerRectWidth - 2, 8, 1); // Clear full inner rect width (minus borders)
      // Center score dynamically
      String s = String(score);
      uint8_t textWidth = s.length() * 6; // 5 pixels/char + 1 spacing
      //uint8_t scoreX = innerRectX + (innerRectWidth - textWidth) / 2; // Center in inner rect
      drawText(scoreX, scoreY, s.c_str(), 0); // Draw black text
      prevScore = score;
    }

    updateDisplay();
  }

  int update() {
    // Handle button input
    bool currentSwitch = digitalRead(BUTTON_MAIN);
    if (currentSwitch != switchStateStable) {
      lastSwitchDebounceTime = millis();
      switchStateStable = currentSwitch;
    }
    if (millis() - lastSwitchDebounceTime >= DEBOUNCE_DELAY) {
      if (lastSwitchState == HIGH && switchStateStable == LOW) { // Button pressed
        direction = (direction + 1) % 4; // Change direction clockwise
        lastSwitchState = switchStateStable;
      }
      lastSwitchState = switchStateStable;
    }

    // Turn off buzzer after duration
    if (buzzerOn && millis() - buzzerStartTime >= SCORE_BEEP_DURATION) {
      digitalWrite(BUZZER_PIN, LOW);
      buzzerOn = false;
    }

    // Move player
    if (millis() - lastMoveTime >= moveInterval) {
      prevPlayerX = playerX;
      prevPlayerY = playerY;
      switch (direction) {
        case 0: playerX += playerSpeed; break; // Right
        case 1: playerY += playerSpeed; break; // Down
        case 2: playerX -= playerSpeed; break; // Left
        case 3: playerY -= playerSpeed; break; // Up
      }
      lastMoveTime = millis();

      // Score on right crossing of start line
      if (direction == 0 && prevPlayerX < startLineX && playerX >= startLineX) {
        score++;
        if (!buzzerOn) {
          digitalWrite(BUZZER_PIN, HIGH);
          buzzerOn = true;
          buzzerStartTime = millis();
        }
      }

      // Check collisions
      if (playerX < borderSize || playerX + playerSize > rightBorderX || playerY < borderSize || playerY + playerSize > bottomBorderY) {
        digitalWrite(BUZZER_PIN, LOW);
        buzzerOn = false;
        return 4; // Game over
      }
      // Inner rectangle (check if any player pixel overlaps)
      if (playerX + playerSize > innerRectX && playerX < innerRectX + innerRectWidth && playerY + playerSize > innerRectY && playerY < innerRectY + innerRectHeight) {
        digitalWrite(BUZZER_PIN, LOW);
        buzzerOn = false;
        return 4; // Game over
      }
      return -1; // Redraw screen
    }

    return 0;
  }
};

PlayScreen playScreen;

class GameOverScreen : public Screen {
private: 
  unsigned long startTime;
  int currentScore;

public: 
  GameOverScreen() {
    reset();
  }

  void reset() {
    startTime = millis();
    //Update high score
    currentScore = playScreen.getScore();
    int highScore = readHighScore();
    if (currentScore > highScore) {
      writeHighScore(currentScore);
    } 
  }

  void draw() {
    clearBuffer();
    drawText(30, 20, "GAME OVER!", 1);
    drawText(30, 40, "YOUR SCORE: ", 1);
    drawText(100, 40, String(currentScore).c_str(), 1);
    updateDisplay();
  }

  int update() {
    if (millis() - startTime >= 3000) {
      return 1; // Back to menu after 3 seconds
    }
    return 0;
  }
};

class HighscoreScreen : public Screen {
private: 
  bool lastSelectState = HIGH;
  bool selectStateStable = HIGH;
  unsigned long lastSelectDebounceTime = 0;
public: 
  HighscoreScreen() {
    pinMode(BUTTON_OTHER, INPUT);
  }
  void draw() {
    clearBuffer();
    drawText(30, 30, "HIGHSCORE: ", 1);
    int highScore = readHighScore();
    drawText(100, 30, String(highScore).c_str(), 1);
    updateDisplay();
  }

  int update() {
    bool currentSelect = digitalRead(BUTTON_OTHER);
    if (currentSelect != selectStateStable) {
      lastSelectDebounceTime = millis();
      selectStateStable = currentSelect;
    }
    if (millis() - lastSelectDebounceTime >= DEBOUNCE_DELAY) {
      if (lastSelectState == HIGH && selectStateStable == LOW) { // Select button pressed
        return 1; // Back to menu
      }
      lastSelectState = selectStateStable;
    }
    return 0;
  }
};

SplashScreen splashScreen;
MenuScreen menuScreen;
GameOverScreen gameOverScreen;
HighscoreScreen highscoreScreen;

ScreenState currentState = SPLASH;
Screen* currentScreen = &splashScreen;

void setup() {
  pinMode(BUZZER_PIN, OUTPUT);
  digitalWrite(BUZZER_PIN, LOW);
  Wire.begin();
  Wire.setClock(400000);
  initDisplay(); 
  currentScreen->draw();
}

void loop() {
  unsigned long loopStart = millis();
  int status = currentScreen->update();
  
  if (status == -1) {
    currentScreen->draw();  // Redraw current screen
  } else if (status > 0) {
    switch (status) {
      case 1:
      currentState = MENU;
      currentScreen = &menuScreen;
      break;
      case 2:
      currentState = PLAY;
      currentScreen = &playScreen;
      playScreen.reset();
      break;
      case 3:
      currentState = HIGHSCORE;
      currentScreen = &highscoreScreen;
      break;
      case 4:
      currentState = GAME_OVER;
      currentScreen = &gameOverScreen;
      gameOverScreen.reset();
      break;
      default:
      break;
    }
    currentScreen->draw();
  }
}

